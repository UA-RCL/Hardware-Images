## petalinux/linux_with_eth/project-spec/configs/rootfsconfigs/Kconfig.user
```kconfig
menu "user packages " 
config gpio-demo  
	 bool "gpio-demo"
	 help
	
config peekpoke  
	 bool "peekpoke"
	 help
	
config u-dma-buf  
	 bool "u-dma-buf"
	 help
	
endmenu
```

## petalinux/project-spec/configs/configs/Kconfig
```kconfig
mainmenu "PetaLinux System Configuration"
config SUBSYSTEM_TYPE_LINUX
        bool
        default y
        select SYSTEM_MICROBLAZE

config SYSTEM_MICROBLAZE
        bool "MICROBLAZE Configuration"
        help
          MICROBLAZE Configuration for petalinux project.
          All these config options will be in /host-fs/mnt/data/Publications/PACT26/tmp/vcu128/petalinux/project-spec/configs/config

config SUBSYSTEM_DISTRO_PETALINUX
        bool
        default y
        help

source /host-fs/mnt/data/Publications/PACT26/tmp/vcu128/petalinux/project-spec/configs/configs/Kconfig.main
```

## petalinux/project-spec/configs/configs/Kconfig.syshw
```kconfig
menu "Subsystem Hardware Settings"

config SUBSYSTEM_PROCESSOR0_IP_NAME
	string
	default microblaze_0

config SUBSYSTEM_PROCESSOR0_INSTANCE_PATH
	string
	default mb_preset_i/microblaze_0

config SUBSYSTEM_ENABLE_ARCHMB
	bool
	default y
	select SUBSYSTEM_ARCH_MICROBLAZE
	depends on SUBSYSTEM_PROCESSOR_microblaze_0_SELECT

choice
	prompt "System Processor"
	help
	Select a processor as the system processor.

config SUBSYSTEM_PROCESSOR_microblaze_0_SELECT
	bool "microblaze_0"

endchoice

if SUBSYSTEM_PROCESSOR_microblaze_0_SELECT

menu "Memory Settings"
choice
	prompt "Primary Memory"
	default SUBSYSTEM_MEMORY_DDR4_0_SELECT

	help
	The configuration in this menu impacts the
	memory settings in the device tree autoconfig files.
	If you select "manual",
	PetaLinux will auto generate memory node based on user inputs,
	you will need to specify base address and memory size.
	To skip generating lower or upper memory node specify 0x0 offset to the memory size.

config SUBSYSTEM_MEMORY_DDR4_0_SELECT
	bool "ddr4_0"

config SUBSYSTEM_MEMORY_MANUAL_SELECT
	bool "manual"

endchoice

config SUBSYSTEM_MEMORY_DDR4_0_BASEADDR
	hex "System memory base address"
	default 0x80000000
	range 0x80000000 0xfdffffff
	depends on SUBSYSTEM_MEMORY_DDR4_0_SELECT
	help
	Start address of the system memory.
	It has to be within the selected primary memory physical address range.
	Make sure the DT memory entry should start with provided address.

config SUBSYSTEM_MEMORY_DDR4_0_SIZE
	hex "System memory size"
	default 0x80000000
	range 0x2000000 0x80000000
	depends on SUBSYSTEM_MEMORY_DDR4_0_SELECT
	help
	Size of the system memory. Minimum is 32MB, maximum is the size of
	the selected primary memory physical address range.

config SUBSYSTEM_MEMORY_DDR4_0_U__BOOT_TEXTBASE_OFFSET
	hex "u-boot text base address"
	default 0x88000000 if SUBSYSTEM_ARCH_AARCH64
	default 0x84000000 if SUBSYSTEM_ARCH_ARM
	default 0x80100000 if SUBSYSTEM_ARCH_MICROBLAZE
	range 0x80100000 0x17e0fffff
	depends on SUBSYSTEM_MEMORY_DDR4_0_SELECT
	depends on !SUBSYSTEM_COMPONENT_U__BOOT_NAME_NONE
	help
	u-boot text base address by specifying from the memory base address.
	u-boot load address = bank base address + offset. And same value will
	pass to TF-A also. Minimum suggested is 1MB.

config SUBSYSTEM_MEMORY_IP_NAME
	string
	default ddr4_0
	depends on SUBSYSTEM_MEMORY_DDR4_0_SELECT

config SUBSYSTEM_MEMORY_MANUAL_LOWER_BASEADDR
	hex "Lower memory base address"
	default 0x0
	depends on SUBSYSTEM_MEMORY_MANUAL_SELECT
	help
	base address of the lower memory
	Make sure the DT memory entry should start with provided address.

config SUBSYSTEM_MEMORY_MANUAL_LOWER_MEMORYSIZE
	hex "Lower memory size"
	default 0x80000000
	depends on SUBSYSTEM_MEMORY_MANUAL_SELECT
	help
	Size of the lower memory. Minimum is 32MB, maximum is the size of
	the selected primary memory physical address range.
	If you specify 0x0 offset then it will skip generating lower memory node.

config SUBSYSTEM_MEMORY_MANUAL_UPPER_BASEADDR
	hex "Upper memory base address"
	default 0x800000000
	depends on SUBSYSTEM_MEMORY_MANUAL_SELECT
	depends on SUBSYSTEM_ARCH_AARCH64
	help
	base address of the upper memory
	Make sure the DT memory entry should start with provided address.

config SUBSYSTEM_MEMORY_MANUAL_UPPER_MEMORYSIZE
	hex "Upper memory size"
	default 0x80000000
	depends on SUBSYSTEM_MEMORY_MANUAL_SELECT
	depends on SUBSYSTEM_ARCH_AARCH64
	help
	Size of the lower memory. Minimum is 32MB, maximum is the size of
	the selected primary memory physical address range.
	If you specify 0x0 offset then it will skip generating lower memory node.

endmenu

menu "Serial Settings"

choice
	prompt "FSBOOT Serial stdin/stdout"
	help
	Select a serial as the FSBOOT's stdin,stdout.
	If you select 'manual', you will need to add this variable
	YAML_SERIAL_CONSOLE_STDIN:forcevariable:pn-<recipename> = "<serial_ipname>"
	YAML_SERIAL_CONSOLE_STDOUT:forcevariable:pn-<recipename> = "<serial_ipname>"
	in petalinuxbsp.conf file to specify the stdin/stdout."

config SUBSYSTEM_FSBOOT_SERIAL_AXI_UARTLITE_0_SELECT
	bool "axi_uartlite_0"

config SUBSYSTEM_FSBOOT_SERIAL_MANUAL_SELECT
	bool "manual"

endchoice

choice
	prompt "U-boot/Linux Serial stdin/stdout"
	help
	Select a serial as the U-boot and Linux's stdin,stdout.
	If you select 'manual', you will need to add this variable
	YAML_SERIAL_CONSOLE_STDIN:forcevariable:pn-<recipename> = "<serial_ipname>"
	YAML_SERIAL_CONSOLE_STDOUT:forcevariable:pn-<recipename> = "<serial_ipname>"
	in petalinuxbsp.conf file to specify the stdin/stdout."

config SUBSYSTEM_SERIAL_AXI_UARTLITE_0_SELECT
	bool "axi_uartlite_0"

config SUBSYSTEM_SERIAL_MANUAL_SELECT
	bool "manual"

endchoice

choice
	prompt "System stdin/stdout baudrate for axi_uartlite_0"
	default SUBSYSTEM_SERIAL_AXI_UARTLITE_0_BAUDRATE_115200
	help
	Baudrate settings for serial Ip axi_uartlite_0
	The Baudrate setting applies only for U-boot/Linux serial Ip

config SUBSYSTEM_SERIAL_AXI_UARTLITE_0_BAUDRATE_600
	bool "600"

config SUBSYSTEM_SERIAL_AXI_UARTLITE_0_BAUDRATE_9600
	bool "9600"

config SUBSYSTEM_SERIAL_AXI_UARTLITE_0_BAUDRATE_28800
	bool "28800"

config SUBSYSTEM_SERIAL_AXI_UARTLITE_0_BAUDRATE_115200
	bool "115200"

config SUBSYSTEM_SERIAL_AXI_UARTLITE_0_BAUDRATE_230400
	bool "230400"

config SUBSYSTEM_SERIAL_AXI_UARTLITE_0_BAUDRATE_460800
	bool "460800"

config SUBSYSTEM_SERIAL_AXI_UARTLITE_0_BAUDRATE_921600
	bool "921600"

endchoice

config SUBSYSTEM_SERIAL_FSBOOT_IP_NAME
	string
	default axi_uartlite_0 if SUBSYSTEM_FSBOOT_SERIAL_AXI_UARTLITE_0_SELECT

config SUBSYSTEM_SERIAL_IP_NAME
	string
	default axi_uartlite_0 if SUBSYSTEM_SERIAL_AXI_UARTLITE_0_SELECT

endmenu

menu "Ethernet Settings"

choice
	prompt "Primary Ethernet"
	help
	Select a Ethernet used as primary Ethernet.
	The primary ethernet will be used for u-boot networking if u-boot is
	selected and will be used as eth0 in Linux.
	If your preferred primary ethernet is not on the list, please select"
	'manual'.

config SUBSYSTEM_ETHERNET_MANUAL_SELECT
	bool "manual"

endchoice

endmenu

menu "Flash Settings"

choice
	prompt "Primary Flash"
	help
	Select a Flash instance used as Primary Flash.
	PetaLinux auto config will apply the flash partition table settings
	to the primary flash.
	If you preferred flash is not on the list or you don't want PetaLinux
	to manage your flash partition, please select manual.

config SUBSYSTEM_FLASH_MANUAL_SELECT
	bool "manual"

endchoice

endmenu

menu "SD/SDIO Settings"

choice
	prompt "Primary SD/SDIO"
	help
	Select a SD instanced used as primary SD/SDIO.
	It allows you to select which SD controller is in the systems primary SD card interface.

config SUBSYSTEM_PRIMARY_SD_MANUAL_SELECT
	bool "manual"

endchoice

endmenu

endif

endmenu
```

## petalinux/project-spec/configs/rootfsconfigs/Kconfig.user
```kconfig
menu "user packages " 
config libgomp  
	 bool "libgomp"
	 help
	
config gdb  
	 bool "gdb"
	 help
	
config gpio-demo  
	 bool "gpio-demo"
	 help
	
config gsl  
	 bool "gsl"
	 help
	
config peekpoke  
	 bool "peekpoke"
	 help
	
config sshfs-fuse  
	 bool "sshfs-fuse"
	 help
	
config u-dma-buf  
	 bool "u-dma-buf"
	 help
	
endmenu
```
