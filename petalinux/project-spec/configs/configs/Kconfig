## petalinux/project-spec/configs/configs/Kconfig
```kconfig
mainmenu "PetaLinux System Configuration"
config SUBSYSTEM_TYPE_LINUX
        bool
        default y
        select SYSTEM_MICROBLAZE

config SYSTEM_MICROBLAZE
        bool "MICROBLAZE Configuration"
        help
          MICROBLAZE Configuration for petalinux project.
          All these config options will be in /scratch/umut/vcu128_eth/petalinux/project-spec/configs/config

config SUBSYSTEM_DISTRO_PETALINUX
        bool
        default y
        help

source /scratch/umut/vcu128_eth/petalinux/project-spec/configs/configs/Kconfig.main
```
